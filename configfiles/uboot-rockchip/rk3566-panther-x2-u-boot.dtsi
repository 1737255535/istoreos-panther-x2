// SPDX-License-Identifier: (GPL-2.0+ OR MIT)
/*
 * Panther X2 (RK3566) U-Boot device tree overlay
 *
 * 基于 rk3568-easepi-u-boot.dtsi，追加 Panther X2 的板级配置。
 * 串口沿用 Rockchip BSP 默认的 UART2 (0xfe660000)，
 * 与 kernel 侧 DTS 中 fiq-debugger / uart2m0_xfer 保持一致。
 */

#include "rk3568-u-boot.dtsi"

/ {
	chosen {
		stdout-path = &uart2;
	};
};

&uart2 {
	clock-frequency = <24000000>;
	bootph-all;
	status = "okay";
};